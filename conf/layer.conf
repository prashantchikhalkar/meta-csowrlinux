## conf/layer.conf
```bitbake
# We have a conf and classes directory, add to BBPATH
BBPATH .= ":${LAYERDIR}"

# We have recipes-* directories, add to BBFILES
BBFILES += "${LAYERDIR}/recipes-*/*/*.bb \
            ${LAYERDIR}/recipes-*/*/*.bbappend"

BBFILE_COLLECTIONS += "meta-csowrlinux"
BBFILE_PATTERN_meta-csowrlinux = "^${LAYERDIR}/"
BBFILE_PRIORITY_meta-csowrlinux = "6"

LAYERDEPENDS_meta-csowrlinux = "core"
LAYERSERIES_COMPAT_meta-csowrlinux = "warrior zeus wrl"
```
